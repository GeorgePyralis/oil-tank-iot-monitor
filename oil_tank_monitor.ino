#include <WiFiNINA.h>
#include <NTPClient.h>
#include <RTCZero.h>
//#include "thingProperties.h" // IoT library
//#include <ArduinoIoTCloud.h> // IoT library
#include <Arduino_ConnectionHandler.h> // For WiFi

/* 
  Sketch generated by the Arduino IoT Cloud Thing "Untitled"
  https://create.arduino.cc/cloud/things/0633f63b-94b4-4eaf-bcac-3214fcac32e8 
*/

/* Create an RTCZero object */
RTCZero rtc; 
WiFiUDP ntpUDP;
NTPClient timeClient(ntpUDP, "pool.ntp.org");

// Replace with your own network credentials
char ssid[] = "COSMOTE_1";  
char pass[] = "AAAAAAAAA";

// Potentiometer pins
#define POTENTIOMETER1_PIN A0
#define POTENTIOMETER2_PIN A2

// tmp36 sensor pin
#define tmp36_pin A5

// Ultrasonic sensor pins
#define echoPin 2
#define trigPin 3

// LED pins
#define red_led 8
#define green_led 7
#define blue_led 4 // In our setup this is also red for temperature, just renamed for distinction

// Tank dimensions (in cm)
float height = 33.0;
float width = 18.0;
float length = 12.0; 
float volume = length * width * height / pow(10, 3);

float counter = 0.0; // Counter for average temperature
float Wo = 0; // Initial volume
float temperature = 0.0;

int readPotentiometer1() {
  analogRead(POTENTIOMETER1_PIN);
  int data1 = analogRead(POTENTIOMETER1_PIN);
  int upperThreshold = map(data1, 0, 1023, 3, 33);
  delay(2);
  return upperThreshold;
}

int readPotentiometer2() {
  analogRead(POTENTIOMETER2_PIN);
  int data2 = analogRead(POTENTIOMETER2_PIN);
  int lowerThreshold = map(data2, 0, 1023, 3, 33);
  delay(2);
  return lowerThreshold;
}

float temp_measure() {
  int temp_adc_val;
  float temp_val;
  temp_adc_val = analogRead(tmp36_pin);  // Read Temperature
  temp_val = temp_adc_val * (3.3 / 1024.0); // Convert ADC value to voltage
  temp_val = (temp_val - 0.5) * 10;  // Convert voltage to temperature (0.5V offset, 10mV/°C)
  return temp_val;
}

float distance_measure() {
  digitalWrite(trigPin, LOW);
  delayMicroseconds(2);
  digitalWrite(trigPin, HIGH);
  delayMicroseconds(10);
  digitalWrite(trigPin, LOW);
  float duration = pulseIn(echoPin, HIGH);
  float distance = duration * 0.034 / 2;
  return distance;
}

void updateRTC() {
  timeClient.update();
  unsigned long epochTime = timeClient.getEpochTime();
  rtc.setEpoch(epochTime);
  Serial.println("Time synchronized with NTP server");
}

void setup() {
  Serial.begin(9600);
  delay(1500); 
  setDebugMessageLevel(2);

  Serial.print("Connecting to WiFi");
  WiFi.begin(ssid, pass);

  while (WiFi.status() != WL_CONNECTED) {
    delay(500);
    Serial.print(".");
  }
  Serial.println("\nConnected to WiFi");

  timeClient.begin();
  timeClient.setTimeOffset(7200); // GMT+2 for Greece

  rtc.begin();
  updateRTC();

  pinMode(red_led, OUTPUT);
  pinMode(green_led, OUTPUT);
  pinMode(blue_led, OUTPUT);

  pinMode(trigPin, OUTPUT);
  pinMode(echoPin, INPUT); // Sets the echoPin as an INPUT
}

void loop() {
  static unsigned long lastSync = 0;
  if (millis() - lastSync >= 3600000) {
    updateRTC();
    lastSync = millis();
  }

  counter += 1.0;

  int upperThreshold = readPotentiometer1();
  int lowerThreshold = readPotentiometer2();
  float current_distance = distance_measure();
  float current_temperature = temp_measure();

  Serial.print("LowerValue="); Serial.println(lowerThreshold);
  Serial.print("UpperValue="); Serial.println(upperThreshold);
  Serial.print("Temperature = "); Serial.print(current_temperature); Serial.println(" Degree Celsius");
  Serial.print("Distance: "); Serial.print(current_distance); Serial.println("cm");

  if (current_distance < lowerThreshold) {
    digitalWrite(red_led, HIGH); 
  } else {
    digitalWrite(red_led, LOW);
  }

  if (current_distance > upperThreshold) {
    digitalWrite(green_led, HIGH); 
  } else {
    digitalWrite(green_led, LOW);
  }

  if (current_distance < upperThreshold && current_distance > lowerThreshold) {
    digitalWrite(red_led, LOW);
    digitalWrite(green_led, LOW);
  }

  if (current_temperature >= 13.5 && current_temperature <= 14.5) {
    digitalWrite(blue_led, HIGH); 
  } else {
    digitalWrite(blue_led, LOW);
  }

  temperature += current_temperature;

  float thermal_variation = abs(current_temperature - thermal_variation);
  float current_litres = (length * width * (height - current_distance) * (1 + (0.00025 * thermal_variation))) / pow(10, 3);

  if (rtc.getHours() == 6 && rtc.getMinutes() == 59 && rtc.getSeconds() == 59) {
    Wo = (height - current_distance) * length * width;
  }

  if (rtc.getHours() == 19 && rtc.getMinutes() == 52 && rtc.getSeconds() == 59) {
    float katanalosi = abs(Wo - current_litres);

    String a = String(rtc.getDay());
    String b = String(rtc.getMonth());
    String c = String(rtc.getYear());
    String d = String(katanalosi);
    String e = String(temperature / counter);

    String date = a + b + c + "_" + d + "_" + e;
    Serial.println(date);
  }

  Serial.print(rtc.getDay()); Serial.print("/");
  Serial.print(rtc.getMonth()); Serial.print("/");
  Serial.print(rtc.getYear()); Serial.print(" - ");
  Serial.print(rtc.getHours()); Serial.print(":");
  Serial.print(rtc.getMinutes()); Serial.print(":");
  Serial.println(rtc.getSeconds());

  delay(1000);
}
